/ {
	amba_pl: amba_pl {
		ranges;
		compatible = "simple-bus";
		#address-cells = <1>;
		#size-cells = <1>;
		axi_slve_0: axi_slve@40000000 {
			xlnx,rable = <0>;
			compatible = "xlnx,axi-slve-1.0";
			status = "okay";
			clock-names = "S_AXI_ACLK";
			xlnx,ip-name = "axi_slve";
			xlnx,edk-iptype = "PERIPHERAL";
			reg = <0x40000000 0x1000>;
			clocks = <&clkc 15>;
			xlnx,name = "axi_slve_0";
		};
	};
};
